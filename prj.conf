## CMakeLists.txt
```
#
# Copyright (c) 2018 Nordic Semiconductor
#
# SPDX-License-Identifier: LicenseRef-Nordic-5-Clause
#
cmake_minimum_required(VERSION 3.20.0)

find_package(Zephyr REQUIRED HINTS $ENV{ZEPHYR_BASE})
project(peripheral_lbs)

# NORDIC SDK APP START
target_sources(app PRIVATE
  src/main.c
  src/app_utils.c
  src/authorizationtoken.c
  src/challengeresponse.c
  src/BLECore.c
)

# NORDIC SDK APP END
zephyr_library_include_directories(.)
```

## prj.conf
```kconfig
#
# Copyright (c) 2018 Nordic Semiconductor
#
# SPDX-License-Identifier: LicenseRef-Nordic-5-Clause
#
CONFIG_NCS_SAMPLES_DEFAULTS=y

CONFIG_BT=y
CONFIG_BT_PERIPHERAL=y
CONFIG_BT_DEVICE_NAME="Keyfob"
CONFIG_BT_MAX_CONN=1
CONFIG_BT_MAX_PAIRED=3

# Security and bonding
CONFIG_BT_SMP=y
CONFIG_BT_BONDABLE=y
CONFIG_BT_PRIVACY=y
CONFIG_BT_SMP_APP_PAIRING_ACCEPT=y
CONFIG_BT_SMP_SC_PAIR_ONLY=y
CONFIG_BT_ECC=y
CONFIG_BT_SMP_ENFORCE_MITM=n


# Stack sizes
CONFIG_BT_RX_STACK_SIZE=4096
CONFIG_SYSTEM_WORKQUEUE_STACK_SIZE=2048
CONFIG_MAIN_STACK_SIZE=3072

# Crypto for token verification and HMAC
# Crypto backend (nrf_security + mbedTLS primitives)
CONFIG_NRF_SECURITY=y
CONFIG_MBEDTLS_LEGACY_CRYPTO_C=y
CONFIG_MBEDTLS_ENABLE_HEAP=y
CONFIG_MBEDTLS_HEAP_SIZE=4096
CONFIG_MBEDTLS_SHA256_C=y
CONFIG_MBEDTLS_MD_C=y
CONFIG_MBEDTLS_PK_C=y
CONFIG_MBEDTLS_PK_PARSE_C=y
CONFIG_MBEDTLS_ECP_C=y
CONFIG_MBEDTLS_ECDSA_C=y
CONFIG_MBEDTLS_ECP_DP_SECP256R1_ENABLED=y
CONFIG_BASE64=y


# Store bonds and settings in flash
CONFIG_FLASH=y
CONFIG_FLASH_PAGE_LAYOUT=y
CONFIG_FLASH_MAP=y
CONFIG_NVS=y
CONFIG_SETTINGS=y
CONFIG_BT_SETTINGS=y

CONFIG_LOG=y
CONFIG_LOG_DEFAULT_LEVEL=3

# Use smaller ATT MTU to reduce RAM usage (chunked writes handle larger payloads)
CONFIG_BT_L2CAP_TX_MTU=65
CONFIG_BT_BUF_ACL_RX_SIZE=256
CONFIG_BT_BUF_ACL_TX_SIZE=256


CONFIG_BT_L2CAP_TX_BUF_COUNT=4
CONFIG_BT_BUF_ACL_RX_COUNT=4
CONFIG_BT_BUF_ACL_TX_COUNT=4
CONFIG_BT_CONN_TX_MAX=4
```

## src/main.c
```c
/*
 * Keyfob commissioning and link-mode firmware
 */

#include <zephyr/types.h>
#include <zephyr/sys/printk.h>
#include <zephyr/kernel.h>
#include <zephyr/bluetooth/bluetooth.h>
#include <zephyr/bluetooth/uuid.h>
#include <zephyr/bluetooth/gatt.h>
#include <dk_buttons_and_leds.h>

#include "app_config.h"
#include "authorizationtoken.h"
#include "challengeresponse.h"
#include "BLECore.h"

/* UUIDs */
#define BT_UUID_COMM_SVC_VAL \
	BT_UUID_128_ENCODE(0x23d7f4a1, 0x8c5e, 0x4af2, 0x91b7, 0x77c3f5a0c101)
#define BT_UUID_TOKEN_CHAR_VAL \
	BT_UUID_128_ENCODE(0x23d7f4a3, 0x8c5e, 0x4af2, 0x91b7, 0x77c3f5a0c101)
#define BT_UUID_CHALLENGE_CHAR_VAL \
	BT_UUID_128_ENCODE(0x23d7f4a4, 0x8c5e, 0x4af2, 0x91b7, 0x77c3f5a0c101)
#define BT_UUID_RESPONSE_CHAR_VAL \
	BT_UUID_128_ENCODE(0x23d7f4a5, 0x8c5e, 0x4af2, 0x91b7, 0x77c3f5a0c101)

static struct bt_uuid_128 comm_svc_uuid = BT_UUID_INIT_128(BT_UUID_COMM_SVC_VAL);
static struct bt_uuid_128 token_char_uuid = BT_UUID_INIT_128(BT_UUID_TOKEN_CHAR_VAL);
static struct bt_uuid_128 challenge_char_uuid = BT_UUID_INIT_128(BT_UUID_CHALLENGE_CHAR_VAL);
static struct bt_uuid_128 response_char_uuid = BT_UUID_INIT_128(BT_UUID_RESPONSE_CHAR_VAL);

static const uint8_t mfg_data[] = {
	COMPANY_ID & 0xFF, (COMPANY_ID >> 8) & 0xFF,
	'K', 'E', 'Y', 'F', '-', '9', '3', '3', '8', '-', 'D', '6', '5', '5'};

	
/* Advertising data */
static const struct bt_data ad[] = {
	BT_DATA_BYTES(BT_DATA_FLAGS, (BT_LE_AD_GENERAL | BT_LE_AD_NO_BREDR)),
	BT_DATA_BYTES(BT_DATA_UUID128_ALL, BT_UUID_COMM_SVC_VAL),
};

static const struct bt_data sd[] = {
	BT_DATA(BT_DATA_NAME_COMPLETE, DEVICE_NAME, DEVICE_NAME_LEN),
	BT_DATA(BT_DATA_MANUFACTURER_DATA, mfg_data, sizeof(mfg_data)),
};

static void button_handler(uint32_t button_state, uint32_t has_changed)
{
	if ((has_changed & DK_BTN1_MSK) && (button_state & DK_BTN1_MSK))
	{
		printk("Button 1 pressed, clearing bonds\n");
		(void)ble_clear_bonds();
	}
}

/* GATT database */
BT_GATT_SERVICE_DEFINE(comm_svc,
					   BT_GATT_PRIMARY_SERVICE(&comm_svc_uuid),
					   BT_GATT_CHARACTERISTIC(&token_char_uuid.uuid,
											  BT_GATT_CHRC_WRITE | BT_GATT_CHRC_NOTIFY,
											  BT_GATT_PERM_WRITE,
											  NULL, token_write, NULL),
					   BT_GATT_CCC(token_ccc_changed, BT_GATT_PERM_READ | BT_GATT_PERM_WRITE),

					   BT_GATT_CHARACTERISTIC(&challenge_char_uuid.uuid,
											  BT_GATT_CHRC_READ | BT_GATT_CHRC_WRITE | BT_GATT_CHRC_NOTIFY,
											  BT_GATT_PERM_READ | BT_GATT_PERM_WRITE,
											  challenge_read, challenge_write, NULL),
					   BT_GATT_CCC(challenge_ccc_changed, BT_GATT_PERM_READ | BT_GATT_PERM_WRITE),

					   BT_GATT_CHARACTERISTIC(&response_char_uuid.uuid,
											  BT_GATT_CHRC_READ | BT_GATT_CHRC_WRITE | BT_GATT_CHRC_NOTIFY,
											  BT_GATT_PERM_READ | BT_GATT_PERM_WRITE,
											  response_read, response_write, NULL),
					   BT_GATT_CCC(response_ccc_changed, BT_GATT_PERM_READ | BT_GATT_PERM_WRITE));

static void init_attr_refs(void)
{
	/* Challenge characteristic value attribute index within the service */
	token_set_attr(&comm_svc.attrs[2]);
	challenge_set_attr(&comm_svc.attrs[5]);
	response_set_attr(&comm_svc.attrs[8]);
}

static int init_crypto_material(void)
{
	if (challenge_load_device_secret())
	{
		return -EINVAL;
	}

	return auth_init_backend_public_key();
}

static int app_init(void)
{
	int err;

	printk("Starting keyfob commissioning app\n");

	err = init_crypto_material();
	if (err)
	{
		printk("Crypto init failed (err %d)\n", err);
		return 0;
	}

	init_attr_refs();

	err = challenge_settings_init();
	if (err)
	{
		printk("Settings handler init failed (err %d)\n", err);
		return 0;
	}

	err = ble_core_start(ad, ARRAY_SIZE(ad), sd, ARRAY_SIZE(sd), true);
	if (err)
	{
		return 0;
	}

	err = dk_buttons_init(button_handler);
	if (err)
	{
		printk("Buttons init failed (err %d)\n", err);
	}

	return 0;
}

int main(void)
{
	if (app_init())
	{
		return 0;
	}
	for (;;)
	{
		k_sleep(K_SECONDS(1));
	}

	return 0;
}
```

## src/BLECore.c
```c
#include "BLECore.h"
#include "app_utils.h"
#include "authorizationtoken.h"
#include "challengeresponse.h"

#include <errno.h>
#include <string.h>
#include <zephyr/sys/printk.h>
#include <zephyr/bluetooth/bluetooth.h>
#include <zephyr/bluetooth/hci.h>
#include <zephyr/bluetooth/uuid.h>
#include <zephyr/bluetooth/gatt.h>
#include <zephyr/kernel.h>
#include <zephyr/settings/settings.h>

struct session_state session;
struct bt_conn *current_conn;
struct bt_conn *keyfob_conn;

static char keyfob_target_id[80];
static uint16_t keyfob_challenge_handle;
static uint16_t keyfob_response_handle;
static uint16_t keyfob_response_ccc_handle;
static uint16_t keyfob_svc_start;
static uint16_t keyfob_svc_end;
static bool keyfob_security_requested;
static struct k_work_delayable keyfob_nonce_work;
static uint8_t keyfob_nonce_retries;
static struct bt_gatt_discover_params discover_params;
static struct bt_gatt_subscribe_params subscribe_params;
static struct bt_gatt_exchange_params keyfob_mtu_params;
static bool keyfob_bond_phase;
static bt_addr_le_t keyfob_last_addr;
static struct k_work_delayable keyfob_bond_work;
struct frag_state
{
	size_t expected_len;
	size_t buf_len;
};
static uint8_t keyfob_resp_buf[256];
static char keyfob_cmd_buf[128];
static struct frag_state keyfob_resp_frag;

#define BT_UUID_COMM_SVC_VAL \
	BT_UUID_128_ENCODE(0x23d7f4a1, 0x8c5e, 0x4af2, 0x91b7, 0x77c3f5a0c101)
#define BT_UUID_CHALLENGE_CHAR_VAL \
	BT_UUID_128_ENCODE(0x23d7f4a4, 0x8c5e, 0x4af2, 0x91b7, 0x77c3f5a0c101)
#define BT_UUID_RESPONSE_CHAR_VAL \
	BT_UUID_128_ENCODE(0x23d7f4a5, 0x8c5e, 0x4af2, 0x91b7, 0x77c3f5a0c101)

static struct bt_uuid_128 keyfob_comm_uuid = BT_UUID_INIT_128(BT_UUID_COMM_SVC_VAL);
static struct bt_uuid_128 keyfob_challenge_uuid = BT_UUID_INIT_128(BT_UUID_CHALLENGE_CHAR_VAL);
static struct bt_uuid_128 keyfob_response_uuid = BT_UUID_INIT_128(BT_UUID_RESPONSE_CHAR_VAL);

static const struct bt_data *adv_ad;
static const struct bt_data *adv_sd;
static size_t adv_ad_len;
static size_t adv_sd_len;
static bool adv_running;
static bool adv_paused_for_scan;
static bool keyfob_scan_pending;
static bool keyfob_scanning;
static struct k_work_delayable secure_ready_work;

static void secure_ready_work_handler(struct k_work *work)
{
	ARG_UNUSED(work);
	if (current_conn)
	{
		token_notify_secure_ready(current_conn);
	}
}

static int adv_start(void)
{
	if (!adv_ad || !adv_sd)
	{
		return -EINVAL;
	}

	int err = bt_le_adv_start(BT_LE_ADV_CONN, adv_ad, adv_ad_len, adv_sd, adv_sd_len);
	if (!err)
	{
		adv_running = true;
	}
	return err;
}

static void adv_stop(void)
{
	if (!adv_running)
	{
		return;
	}

	if (bt_le_adv_stop() == 0)
	{
		adv_running = false;
	}
}

static void keyfob_reset_discovery(void)
{
	keyfob_challenge_handle = 0;
	keyfob_response_handle = 0;
	keyfob_response_ccc_handle = 0;
	keyfob_svc_start = 0;
	keyfob_svc_end = 0;
	keyfob_security_requested = false;
	keyfob_nonce_retries = 0;
	(void)k_work_cancel_delayable(&keyfob_nonce_work);
	(void)k_work_cancel_delayable(&keyfob_bond_work);
	memset(&discover_params, 0, sizeof(discover_params));
	memset(&subscribe_params, 0, sizeof(subscribe_params));
	memset(&keyfob_resp_frag, 0, sizeof(keyfob_resp_frag));
}

static void keyfob_start_discovery(struct bt_conn *conn);

static uint8_t keyfob_notify_cb(struct bt_conn *conn,
								struct bt_gatt_subscribe_params *params,
								const void *data, uint16_t length)
{
	ARG_UNUSED(conn);

	if (!data || length == 0)
	{
		return BT_GATT_ITER_CONTINUE;
	}

	printk("Keyfob response notify received (%u bytes)\n", length);
	if (length >= sizeof(keyfob_resp_buf))
	{
		return BT_GATT_ITER_CONTINUE;
	}

	char type[16];
	if (length < sizeof(keyfob_cmd_buf))
	{
		memcpy(keyfob_cmd_buf, data, length);
		keyfob_cmd_buf[length] = '\0';
		if (json_extract_string(keyfob_cmd_buf, "type", type, sizeof(type)))
		{
			if (strcmp(type, "FRAG_HDR") == 0)
			{
				uint32_t total_len = 0;
				if (!json_extract_uint(keyfob_cmd_buf, "len", &total_len))
				{
					return BT_GATT_ITER_CONTINUE;
				}
				if (total_len == 0 || total_len > sizeof(keyfob_resp_buf))
				{
					return BT_GATT_ITER_CONTINUE;
				}
				memset(&keyfob_resp_frag, 0, sizeof(keyfob_resp_frag));
				keyfob_resp_frag.expected_len = total_len;
				keyfob_resp_frag.buf_len = 0;
				return BT_GATT_ITER_CONTINUE;
			}
			else if (strcmp(type, "FRAG") == 0)
			{
				char data_b64[128];
				if (!json_extract_string(keyfob_cmd_buf, "data", data_b64, sizeof(data_b64)))
				{
					return BT_GATT_ITER_CONTINUE;
				}
				if (keyfob_resp_frag.expected_len == 0)
				{
					return BT_GATT_ITER_CONTINUE;
				}
				uint8_t chunk[128];
				size_t chunk_len = 0;
				if (base64_decode_str(data_b64, chunk, sizeof(chunk), &chunk_len))
				{
					return BT_GATT_ITER_CONTINUE;
				}
				if (keyfob_resp_frag.buf_len + chunk_len > sizeof(keyfob_resp_buf))
				{
					return BT_GATT_ITER_CONTINUE;
				}
				memcpy(keyfob_resp_buf + keyfob_resp_frag.buf_len, chunk, chunk_len);
				keyfob_resp_frag.buf_len += chunk_len;
				if (keyfob_resp_frag.buf_len >= keyfob_resp_frag.expected_len)
				{
					size_t total = keyfob_resp_frag.buf_len;
					memset(&keyfob_resp_frag, 0, sizeof(keyfob_resp_frag));
					(void)challenge_process_response_json(current_conn, keyfob_resp_buf, total);
				}
				return BT_GATT_ITER_CONTINUE;
			}
		}
	}

	(void)challenge_process_response_json(current_conn, data, length);
	return BT_GATT_ITER_CONTINUE;
}

static void keyfob_send_nonce(void)
{
	if (!keyfob_conn || keyfob_challenge_handle == 0)
	{
		return;
	}

	const char *json = NULL;
	size_t json_len = 0;
	challenge_get_last_json(&json, &json_len);
	if (!session.challenge_sent || !json || json_len == 0)
	{
		if (challenge_send_nonce(current_conn))
		{
			return;
		}
		challenge_get_last_json(&json, &json_len);
	}
	if (!json || json_len == 0)
	{
		return;
	}

	int werr = bt_gatt_write_without_response(keyfob_conn, keyfob_challenge_handle,
											  json, json_len, false);
	if (werr)
	{
		printk("Keyfob nonce write failed (err %d)\n", werr);
		if ((werr == -ENOMEM || werr == -EAGAIN) && keyfob_nonce_retries < 10)
		{
			keyfob_nonce_retries++;
			(void)k_work_schedule(&keyfob_nonce_work, K_MSEC(500));
		}
		return;
	}
	printk("Keyfob nonce sent\n");

	if (keyfob_bond_phase && !keyfob_security_requested)
	{
		int sec_err = bt_conn_set_security(keyfob_conn, BT_SECURITY_L2);
		if (sec_err)
		{
			printk("Keyfob security request failed (err %d)\n", sec_err);
		}
		else
		{
			printk("Keyfob security request started\n");
		}
		keyfob_security_requested = true;
	}
}

static void keyfob_nonce_work_handler(struct k_work *work)
{
	ARG_UNUSED(work);
	keyfob_send_nonce();
}

static void keyfob_bond_work_handler(struct k_work *work)
{
	ARG_UNUSED(work);
	if (!keyfob_bond_phase)
	{
		return;
	}
	int err = bt_conn_le_create(&keyfob_last_addr, BT_CONN_LE_CREATE_CONN,
								BT_LE_CONN_PARAM_DEFAULT, &keyfob_conn);
	if (err)
	{
		printk("Keyfob bond phase reconnect failed (err %d)\n", err);
		keyfob_bond_phase = false;
	}
}

static void keyfob_mtu_exchange_cb(struct bt_conn *conn, uint8_t err,
								   struct bt_gatt_exchange_params *params)
{
	ARG_UNUSED(params);
	if (err)
	{
		printk("Keyfob MTU exchange failed (err %u)\n", err);
	}
	else
	{
		printk("Keyfob MTU exchange complete\n");
	}
	keyfob_start_discovery(conn);
}

static uint8_t keyfob_discover_cb(struct bt_conn *conn,
								  const struct bt_gatt_attr *attr,
								  struct bt_gatt_discover_params *params)
{
	if (!attr)
	{
		if (params->type == BT_GATT_DISCOVER_CHARACTERISTIC &&
			keyfob_response_handle && keyfob_svc_end)
		{
			printk("Keyfob service discovered, searching CCC\n");
			discover_params.uuid = BT_UUID_GATT_CCC;
			discover_params.start_handle = keyfob_response_handle + 1;
			discover_params.end_handle = keyfob_svc_end;
			discover_params.type = BT_GATT_DISCOVER_DESCRIPTOR;
			int derr = bt_gatt_discover(conn, &discover_params);
			if (derr)
			{
				printk("Keyfob CCC discover failed (err %d)\n", derr);
			}
		}
		else if (params->type == BT_GATT_DISCOVER_DESCRIPTOR)
		{
			printk("Keyfob CCC not found in range\n");
			if (keyfob_response_handle && keyfob_svc_end &&
				keyfob_response_handle + 1 <= keyfob_svc_end)
			{
				keyfob_response_ccc_handle = keyfob_response_handle + 1;
				subscribe_params.notify = keyfob_notify_cb;
				subscribe_params.value = BT_GATT_CCC_NOTIFY;
				subscribe_params.value_handle = keyfob_response_handle;
				subscribe_params.ccc_handle = keyfob_response_ccc_handle;
				int serr = bt_gatt_subscribe(conn, &subscribe_params);
				if (serr)
				{
					printk("Keyfob subscribe fallback failed (err %d)\n", serr);
				}
				else
				{
					printk("Keyfob response subscribed (fallback)\n");
				}
				(void)k_work_schedule(&keyfob_nonce_work, K_MSEC(1000));
			}
		}
		return BT_GATT_ITER_STOP;
	}

	if (params->type == BT_GATT_DISCOVER_PRIMARY)
	{
		const struct bt_gatt_service_val *svc = attr->user_data;
		keyfob_svc_start = attr->handle + 1;
		keyfob_svc_end = svc->end_handle;
		printk("Keyfob service found handles [%u..%u]\n", keyfob_svc_start, keyfob_svc_end);

		discover_params.uuid = NULL;
		discover_params.start_handle = keyfob_svc_start;
		discover_params.end_handle = keyfob_svc_end;
		discover_params.type = BT_GATT_DISCOVER_CHARACTERISTIC;
		int derr = bt_gatt_discover(conn, &discover_params);
		if (derr)
		{
			printk("Keyfob char discover failed (err %d)\n", derr);
		}
		return BT_GATT_ITER_STOP;
	}

	if (params->type == BT_GATT_DISCOVER_CHARACTERISTIC)
	{
		const struct bt_gatt_chrc *chrc = attr->user_data;
		if (!bt_uuid_cmp(chrc->uuid, &keyfob_challenge_uuid.uuid))
		{
			keyfob_challenge_handle = chrc->value_handle;
			printk("Keyfob challenge handle %u\n", keyfob_challenge_handle);
		}
		if (!bt_uuid_cmp(chrc->uuid, &keyfob_response_uuid.uuid))
		{
			keyfob_response_handle = chrc->value_handle;
			printk("Keyfob response handle %u\n", keyfob_response_handle);
		}
		return BT_GATT_ITER_CONTINUE;
	}

	if (params->type == BT_GATT_DISCOVER_DESCRIPTOR)
	{
		if (!bt_uuid_cmp(attr->uuid, BT_UUID_GATT_CCC))
		{
		keyfob_response_ccc_handle = attr->handle;
		printk("Keyfob response CCC handle %u\n", keyfob_response_ccc_handle);
		subscribe_params.notify = keyfob_notify_cb;
		subscribe_params.value = BT_GATT_CCC_NOTIFY;
		subscribe_params.value_handle = keyfob_response_handle;
		subscribe_params.ccc_handle = keyfob_response_ccc_handle;
		int serr = bt_gatt_subscribe(conn, &subscribe_params);
		if (serr)
		{
			printk("Keyfob subscribe failed (err %d)\n", serr);
		}
		else
		{
			printk("Keyfob response subscribed\n");
		}
		(void)k_work_schedule(&keyfob_nonce_work, K_MSEC(1000));
		return BT_GATT_ITER_STOP;
	}
		return BT_GATT_ITER_CONTINUE;
	}

	return BT_GATT_ITER_STOP;
}

static void keyfob_start_discovery(struct bt_conn *conn)
{
	keyfob_reset_discovery();
	printk("Keyfob discovery started\n");
	discover_params.uuid = &keyfob_comm_uuid.uuid;
	discover_params.start_handle = BT_ATT_FIRST_ATTRIBUTE_HANDLE;
	discover_params.end_handle = BT_ATT_LAST_ATTRIBUTE_HANDLE;
	discover_params.type = BT_GATT_DISCOVER_PRIMARY;
	discover_params.func = keyfob_discover_cb;
	int derr = bt_gatt_discover(conn, &discover_params);
	if (derr)
	{
		printk("Keyfob discover start failed (err %d)\n", derr);
	}
	else
	{
		printk("Keyfob discover start\n");
	}
}

static bool parse_uuid_ad(struct bt_data *data, void *user_data)
{
	bool *match = user_data;
	struct bt_uuid_128 uuid;

	if (data->type != BT_DATA_UUID128_ALL &&
		data->type != BT_DATA_UUID128_SOME)
	{
		return true;
	}

	for (size_t i = 0; i + 16 <= data->data_len; i += 16)
	{
		memcpy(&uuid.val, &data->data[i], 16);
		uuid.uuid.type = BT_UUID_TYPE_128;
		if (!bt_uuid_cmp(&uuid.uuid, &keyfob_comm_uuid.uuid))
		{
			*match = true;
			return false;
		}
	}

	return true;
}

static bool parse_name_ad(struct bt_data *data, void *user_data)
{
	bool *match = user_data;

	if (data->type != BT_DATA_NAME_COMPLETE &&
		data->type != BT_DATA_NAME_SHORTENED)
	{
		return true;
	}
	if (data->data_len == 0)
	{
		return true;
	}

	char name[32];
	size_t copy_len = MIN(data->data_len, sizeof(name) - 1);
	memcpy(name, data->data, copy_len);
	name[copy_len] = '\0';
	if (strstr(name, "Keyfob") ||
		(keyfob_target_id[0] && strstr(name, keyfob_target_id)))
	{
		*match = true;
		return false;
	}

	return true;
}

static bool ad_has_uuid(struct net_buf_simple *ad)
{
	bool found = false;

	bt_data_parse(ad, parse_uuid_ad, &found);
	return found;
}

static void scan_recv_legacy(const bt_addr_le_t *addr, int8_t rssi,
							 uint8_t type, struct net_buf_simple *ad)
{
	bool name_match = false;

	ARG_UNUSED(rssi);
	ARG_UNUSED(type);

	if (keyfob_conn)
	{
		return;
	}

	if (!ad_has_uuid(ad))
	{
		return;
	}

	bt_data_parse(ad, parse_name_ad, &name_match);

	if (!name_match && keyfob_target_id[0])
	{
		/* If name isn't present, allow UUID-only match. */
	}

	bt_le_scan_stop();
	keyfob_scanning = false;
	bt_addr_le_copy(&keyfob_last_addr, addr);
	printk("Keyfob advertisement matched, connecting\n");
	bt_conn_le_create(addr, BT_CONN_LE_CREATE_CONN,
					  BT_LE_CONN_PARAM_DEFAULT, &keyfob_conn);
}

static void reset_session(void)
{
	memset(&session, 0, sizeof(session));
	token_reset();
	if (challenge_link_pending())
	{
		challenge_reset_preserve_expected();
	}
	else
	{
		challenge_reset();
	}
}

static void connected(struct bt_conn *conn, uint8_t err)
{
	if (err)
	{
		printk("Connection failed (err %u)\n", err);
		return;
	}

	struct bt_conn_info info;
	if (bt_conn_get_info(conn, &info) == 0 &&
		info.role == BT_CONN_ROLE_CENTRAL)
	{
		printk("Keyfob connected\n");
		keyfob_conn = bt_conn_ref(conn);
		if (keyfob_bond_phase)
		{
			int sec_err = bt_conn_set_security(conn, BT_SECURITY_L2);
			if (sec_err)
			{
				printk("Keyfob bond phase security failed (err %d)\n", sec_err);
			}
			else
			{
				printk("Keyfob bond phase security requested\n");
			}
			return;
		}
		keyfob_mtu_params.func = keyfob_mtu_exchange_cb;
		int merr = bt_gatt_exchange_mtu(conn, &keyfob_mtu_params);
		if (merr)
		{
			printk("Keyfob MTU exchange start failed (err %d)\n", merr);
			keyfob_start_discovery(conn);
		}
		return;
	}

	current_conn = bt_conn_ref(conn);
	reset_session();

	/* Wait for CCC subscription before notifying. */

	printk("Connected, requesting security level 2 (LESC)\n");

	err = bt_conn_set_security(conn, BT_SECURITY_L2);
	if (err)
	{
		printk("bt_conn_set_security failed (err %d)\n", err);
	}
}

static void disconnected(struct bt_conn *conn, uint8_t reason)
{
	printk("Disconnected (reason %u)\n", reason);
	struct bt_conn_info info;
	if (bt_conn_get_info(conn, &info) == 0 &&
		info.role == BT_CONN_ROLE_CENTRAL)
	{
		if (keyfob_conn)
		{
			bt_conn_unref(keyfob_conn);
			keyfob_conn = NULL;
		}
		keyfob_reset_discovery();
		keyfob_scanning = false;
		if (adv_paused_for_scan)
		{
			adv_paused_for_scan = false;
			if (adv_start() == 0)
			{
				printk("Advertising restarted\n");
			}
		}
		if (keyfob_bond_phase)
		{
			(void)k_work_schedule(&keyfob_bond_work, K_MSEC(500));
		}
		return;
	}
	if (current_conn)
	{
		bt_conn_unref(current_conn);
		current_conn = NULL;
	}
	reset_session();
	if (keyfob_scan_pending)
	{
		keyfob_scan_pending = false;
		(void)ble_link_keyfob_start(keyfob_target_id);
	}
}

static void security_changed(struct bt_conn *conn, bt_security_t level, enum bt_security_err err)
{
	char addr[BT_ADDR_LE_STR_LEN];

	bt_addr_le_to_str(bt_conn_get_dst(conn), addr, sizeof(addr));
	if (err)
	{
		printk("Security change failed with %s level %u (err %d)\n", addr, level, err);
	}
	else
	{
		printk("Security changed with %s level %u\n", addr, level);
		if (level >= BT_SECURITY_L2)
		{
			struct bt_conn_info info;
			if (bt_conn_get_info(conn, &info) == 0)
			{
				if (info.role == BT_CONN_ROLE_PERIPHERAL)
				{
					(void)k_work_schedule(&secure_ready_work, K_MSEC(200));
				}
				else
				{
					printk("Keyfob security level %u\n", level);
					if (keyfob_bond_phase)
					{
						printk("Keyfob bonded with L2\n");
						keyfob_bond_phase = false;
					}
				}
			}
		}
	}
}

BT_CONN_CB_DEFINE(conn_callbacks) = {
	.connected = connected,
	.disconnected = disconnected,
	.security_changed = security_changed,
};

static void auth_cancel(struct bt_conn *conn)
{
	printk("Auth request cancelled\n");
}

static enum bt_security_err pairing_accept(struct bt_conn *conn,
										   const struct bt_conn_pairing_feat *const feat)
{
	char addr[BT_ADDR_LE_STR_LEN];

	bt_addr_le_to_str(bt_conn_get_dst(conn), addr, sizeof(addr));
	printk("Pairing accept from %s io_cap=%u oob=%u auth_req=0x%02x key_size=%u\n",
		   addr, feat->io_capability, feat->oob_data_flag, feat->auth_req,
		   feat->max_enc_key_size);
	printk("Pairing keys init=0x%02x resp=0x%02x\n",
		   feat->init_key_dist, feat->resp_key_dist);
	return BT_SECURITY_ERR_SUCCESS;
}

static const struct bt_conn_auth_cb auth_cb = {
	.pairing_accept = pairing_accept,
	.cancel = auth_cancel,
};

static void pairing_complete(struct bt_conn *conn, bool bonded)
{
	char addr[BT_ADDR_LE_STR_LEN];

	bt_addr_le_to_str(bt_conn_get_dst(conn), addr, sizeof(addr));
	session.bonded = bonded;
	printk("Pairing completed with %s (bonded=%d)\n", addr, bonded);
}

static void pairing_failed(struct bt_conn *conn, enum bt_security_err reason)
{
	char addr[BT_ADDR_LE_STR_LEN];

	bt_addr_le_to_str(bt_conn_get_dst(conn), addr, sizeof(addr));
	session.bonded = false;
	printk("Pairing failed with %s (reason=%d)\n", addr, reason);
}

static struct bt_conn_auth_info_cb auth_info_cb = {
	.pairing_complete = pairing_complete,
	.pairing_failed = pairing_failed,
};

int ble_clear_bonds(void)
{
	int err = bt_unpair(BT_ID_DEFAULT, BT_ADDR_LE_ANY);

	if (err)
	{
		printk("Bond clear failed: %d\n", err);
	}
	else
	{
		printk("Bonds cleared\n");
	}
	return err;
}

int ble_core_init(void)
{
	int err = bt_conn_auth_cb_register(&auth_cb);
	if (err)
	{
		printk("Failed to register auth callbacks: %d\n", err);
		return err;
	}

	err = bt_conn_auth_info_cb_register(&auth_info_cb);
	if (err)
	{
		printk("Failed to register auth info callbacks: %d\n", err);
		return err;
	}

	return 0;
}

int ble_core_start(const struct bt_data *ad, size_t ad_len,
				   const struct bt_data *sd, size_t sd_len,
				   bool load_settings)
{
	int err;

	err = bt_enable(NULL);
	if (err)
	{
		printk("Bluetooth init failed (err %d)\n", err);
		return err;
	}

	printk("Bluetooth initialized\n");
	adv_ad = ad;
	adv_sd = sd;
	adv_ad_len = ad_len;
	adv_sd_len = sd_len;
	k_work_init_delayable(&secure_ready_work, secure_ready_work_handler);
	k_work_init_delayable(&keyfob_nonce_work, keyfob_nonce_work_handler);
	k_work_init_delayable(&keyfob_bond_work, keyfob_bond_work_handler);

	if (load_settings && IS_ENABLED(CONFIG_SETTINGS))
	{
		settings_load();
		printk("Settings loaded\n");
	}

	/* Clear existing bonds to avoid stale keys during development */
	(void)ble_clear_bonds();

	err = ble_core_init();
	if (err)
	{
		printk("BLE core init failed (err %d)\n", err);
		return err;
	}

	err = adv_start();
	if (err)
	{
		printk("Advertising failed to start (err %d)\n", err);
		return err;
	}

	printk("Advertising started\n");
	return 0;
}

int ble_link_keyfob_start(const char *keyfob_id)
{
	if (!keyfob_id || !keyfob_id[0])
	{
		return -EINVAL;
	}

	strncpy(keyfob_target_id, keyfob_id, sizeof(keyfob_target_id));
	keyfob_target_id[sizeof(keyfob_target_id) - 1] = '\0';

	printk("Keyfob scan requested (connected=%s scanning=%s)\n",
		   current_conn ? "yes" : "no",
		   keyfob_scanning ? "yes" : "no");
	printk("Keyfob target id: %s\n", keyfob_target_id);

	if (keyfob_conn)
	{
		return -EALREADY;
	}

	if (keyfob_scanning)
	{
		return -EALREADY;
	}

	if (current_conn)
	{
		keyfob_scan_pending = true;
		return 0;
	}

	(void)bt_le_scan_stop();
	adv_stop();
	adv_paused_for_scan = true;

	struct bt_le_scan_param scan_param = {
		.type = BT_HCI_LE_SCAN_ACTIVE,
		.options = BT_LE_SCAN_OPT_NONE,
		.interval = 0x0010,
		.window = 0x0010,
	};

	int err = bt_le_scan_start(&scan_param, scan_recv_legacy);
	if (err)
	{
		printk("Keyfob scan start failed (err %d)\n", err);
		adv_paused_for_scan = false;
		(void)adv_start();
		keyfob_scanning = false;
	}
	else
	{
		keyfob_scanning = true;
		printk("Keyfob scan started\n");
	}
	return err;
}

void ble_keyfob_bond_phase_start(void)
{
	if (keyfob_bond_phase)
	{
		return;
	}
	keyfob_bond_phase = true;
	if (keyfob_conn)
	{
		(void)bt_conn_disconnect(keyfob_conn, BT_HCI_ERR_REMOTE_USER_TERM_CONN);
	}
}
```

## src/BLECore.h
```c
#pragma once

#include <zephyr/bluetooth/conn.h>
#include <stdbool.h>
#include <stddef.h>

struct session_state
{
	bool token_ok;
	bool challenge_sent;
	bool trusted;
	bool bonded;
	uint8_t nonce[16];
	size_t nonce_len;
};

extern struct session_state session;
extern struct bt_conn *current_conn;
extern struct bt_conn *keyfob_conn;

int ble_clear_bonds(void);
int ble_core_init(void);
int ble_core_start(const struct bt_data *ad, size_t ad_len,
				   const struct bt_data *sd, size_t sd_len,
				   bool load_settings);
int ble_link_keyfob_start(const char *keyfob_id);
void ble_keyfob_bond_phase_start(void);
```

## src/app_config.h
```c
#pragma once

#define DEVICE_NAME CONFIG_BT_DEVICE_NAME
#define DEVICE_NAME_LEN (sizeof(DEVICE_NAME) - 1)

#define SERIAL_KEY "KEYF-9338-D655"
#define NODE_ID_EXPECTED "79a929f7-a5d2-4095-b01e-4287de27e0f3"
#define DEVICE_SECRET_HEX "49a723a7840986990b06d9ecb80391bd46ac2f77b85dc13ee3ee9f8607326e60"
#define BACKEND_PUBKEY_B64 "MFkwEwYHKoZIzj0CAQYIKoZIzj0DAQcDQgAE9n3YE1g8VmXzMz4255uFYfpN80IJK4h4UGUC0HvYzsYQK3R/Eb/7Z8dzlZdmmbKdAKK48PO3YronISUF1qCovQ=="
#define COMPANY_ID 0xFFFF
#define LINKED_IMMO_SETTINGS_KEY "linked_immobiliser_id"
```

## src/app_utils.c
```c
#include "app_utils.h"

#include <string.h>
#include <stdlib.h>
#include <errno.h>
#include <zephyr/sys/base64.h>

bool hex_to_bytes(const char *hex, uint8_t *out, size_t out_len)
{
	size_t len = strlen(hex);

	if (len != out_len * 2)
	{
		return false;
	}

	for (size_t i = 0; i < out_len; i++)
	{
		char byte_str[3] = {hex[i * 2], hex[i * 2 + 1], 0};
		char *end = NULL;
		long v = strtol(byte_str, &end, 16);
		if (end == byte_str || v < 0 || v > 0xFF)
		{
			return false;
		}
		out[i] = (uint8_t)v;
	}

	return true;
}

int base64_decode_str(const char *b64, uint8_t *out, size_t out_size, size_t *out_len)
{
	int ret = base64_decode(out, out_size, out_len, (const uint8_t *)b64, strlen(b64));

	return ret == 0 ? 0 : -EINVAL;
}

bool json_extract_string(const char *json, const char *key, char *out, size_t out_len)
{
	const char *pos = strstr(json, key);

	if (!pos)
	{
		return false;
	}

	pos = strchr(pos, ':');
	if (!pos)
	{
		return false;
	}

	pos = strchr(pos, '"');
	if (!pos)
	{
		return false;
	}
	pos++;

	const char *end = strchr(pos, '"');
	if (!end)
	{
		return false;
	}

	size_t len = end - pos;
	if (len + 1 > out_len)
	{
		return false;
	}

	memcpy(out, pos, len);
	out[len] = '\0';
	return true;
}

bool json_extract_uint(const char *json, const char *key, uint32_t *out)
{
	const char *pos = strstr(json, key);

	if (!pos)
	{
		return false;
	}

	pos = strchr(pos, ':');
	if (!pos)
	{
		return false;
	}
	pos++;

	while (*pos == ' ' || *pos == '\t')
	{
		pos++;
	}

	char *end = NULL;
	long v = strtol(pos, &end, 10);
	if (end == pos || v < 0)
	{
		return false;
	}

	*out = (uint32_t)v;
	return true;
}

void notify_json(struct bt_conn *conn, const struct bt_gatt_attr *attr,
				 const char *json, uint8_t notify_flag)
{
	if (!conn || notify_flag != BT_GATT_CCC_NOTIFY)
	{
		return;
	}

	bt_gatt_notify(conn, attr, json, strlen(json));
}
```

## src/app_utils.h
```c
#pragma once

#include <zephyr/bluetooth/conn.h>
#include <zephyr/bluetooth/gatt.h>
#include <stdbool.h>
#include <stddef.h>

bool hex_to_bytes(const char *hex, uint8_t *out, size_t out_len);
int base64_decode_str(const char *b64, uint8_t *out, size_t out_size, size_t *out_len);
bool json_extract_string(const char *json, const char *key, char *out, size_t out_len);
bool json_extract_uint(const char *json, const char *key, uint32_t *out);
void notify_json(struct bt_conn *conn, const struct bt_gatt_attr *attr,
				 const char *json, uint8_t notify_flag);
```

## src/authorizationtoken.c
```c
#include "BLECore.h"
#include "app_config.h"
#include "app_utils.h"
#include "authorizationtoken.h"
#include "challengeresponse.h"

#include <errno.h>
#include <string.h>
#include <zephyr/sys/printk.h>
#include <zephyr/sys/base64.h>
#include <zephyr/sys/util.h>
#include <mbedtls/md.h>
#include <mbedtls/pk.h>
#include <mbedtls/sha256.h>

static char last_token_status[96];
static uint8_t token_notify_enabled;
static const struct bt_gatt_attr *token_attr;
static bool secure_ready_pending;

static uint8_t token_buf[1024];
static size_t token_buf_len;
static char token_cmd_buf[256];

struct frag_state
{
	size_t expected_len;
	size_t buf_len;
};

static struct frag_state token_frag;

static mbedtls_pk_context backend_pk;
static bool backend_pk_ready;

static int verify_signature_es256(const uint8_t *payload, size_t payload_len,
								  const uint8_t *sig_der, size_t sig_len)
{
	if (!backend_pk_ready)
	{
		return -EFAULT;
	}

	uint8_t hash[32];
	int ret = mbedtls_sha256(payload, payload_len, hash, 0);
	if (ret)
	{
		return -EINVAL;
	}

	ret = mbedtls_pk_verify(&backend_pk, MBEDTLS_MD_SHA256, hash, sizeof(hash),
							sig_der, sig_len);
	if (ret)
	{
		return -EACCES;
	}

	return 0;
}

static void publish_token_result(struct bt_conn *conn, const struct bt_gatt_attr *attr,
								 const char *type, const char *status)
{
	snprintk(last_token_status, sizeof(last_token_status),
			 "{\"type\":\"%s\",\"status\":\"%s\"}", type, status);
	notify_json(conn, attr, last_token_status, token_notify_enabled);
}

static ssize_t process_token_json(struct bt_conn *conn, const struct bt_gatt_attr *attr,
								  const char *json, size_t len)
{
	char cmd[32];
	char immobiliser_id[80];
	char link_key_hex[80];
	static char payload_b64[512];
	static char signature_b64[256];
	static uint8_t payload_buf[512];
	static uint8_t sig_buf[128];
	static char payload_json[768];
	char node_id[80];
	size_t payload_len = 0;
	size_t sig_len = 0;

	if (json_extract_string(json, "cmd", cmd, sizeof(cmd)))
	{
		if (strcmp(cmd, "ENTER_LINK_MODE") != 0)
		{
			publish_token_result(conn, attr, "LINK_MODE_RESULT", "ERROR");
			return len;
		}

		if (!json_extract_string(json, "immobiliserId", immobiliser_id, sizeof(immobiliser_id)))
		{
			publish_token_result(conn, attr, "LINK_MODE_RESULT", "ERROR");
			return len;
		}

		if (!json_extract_string(json, "linkKeyHex", link_key_hex, sizeof(link_key_hex)) ||
			challenge_set_link_key_hex(link_key_hex))
		{
			publish_token_result(conn, attr, "LINK_MODE_RESULT", "ERROR");
			return len;
		}
		printk("Link key received: %s\n", link_key_hex);

		session.token_ok = true;
		challenge_set_expected_immobiliser_id(immobiliser_id);
		(void)ble_adv_restart();
		publish_token_result(conn, attr, "LINK_MODE_RESULT", "OK");
		printk("Link mode enabled for immobiliser %s\n", immobiliser_id);
		return len;
	}

	if (!json_extract_string(json, "payload", payload_b64, sizeof(payload_b64)) ||
		!json_extract_string(json, "signature", signature_b64, sizeof(signature_b64)))
	{
		publish_token_result(conn, attr, "PAIR_TOKEN_RESULT", "ERROR");
		return len;
	}

	if (base64_decode_str(payload_b64, payload_buf, sizeof(payload_buf), &payload_len) ||
		base64_decode_str(signature_b64, sig_buf, sizeof(sig_buf), &sig_len))
	{
		publish_token_result(conn, attr, "PAIR_TOKEN_RESULT", "ERROR");
		return len;
	}

	if (payload_len >= sizeof(payload_json))
	{
		publish_token_result(conn, attr, "PAIR_TOKEN_RESULT", "ERROR");
		return len;
	}
	memcpy(payload_json, payload_buf, payload_len);
	payload_json[payload_len] = '\0';

	if (json_extract_string(payload_json, "keyfobNodeId", node_id, sizeof(node_id)))
	{
		if (strcmp(node_id, NODE_ID_EXPECTED) != 0)
		{
			publish_token_result(conn, attr, "PAIR_TOKEN_RESULT", "ERROR");
			return len;
		}
	}
	else if (json_extract_string(payload_json, "nodeId", node_id, sizeof(node_id)))
	{
		if (strcmp(node_id, NODE_ID_EXPECTED) != 0)
		{
			publish_token_result(conn, attr, "PAIR_TOKEN_RESULT", "ERROR");
			return len;
		}
	}
	else
	{
		publish_token_result(conn, attr, "PAIR_TOKEN_RESULT", "ERROR");
		return len;
	}

	if (verify_signature_es256(payload_buf, payload_len, sig_buf, sig_len))
	{
		publish_token_result(conn, attr, "PAIR_TOKEN_RESULT", "ERROR");
		return len;
	}

	session.token_ok = true;
	publish_token_result(conn, attr, "PAIR_TOKEN_RESULT", "OK");
	printk("Token validated for node %s\n", node_id);
	if (!session.challenge_sent)
	{
		int serr = challenge_send_nonce(conn);
		if (serr)
		{
			printk("Nonce send failed\n");
		}
	}

	return len;
}

int auth_init_backend_public_key(void)
{
	uint8_t der_buf[200];
	size_t der_len = 0;
	int ret;

	mbedtls_pk_init(&backend_pk);

	ret = base64_decode(der_buf, sizeof(der_buf), &der_len,
						(const uint8_t *)BACKEND_PUBKEY_B64, strlen(BACKEND_PUBKEY_B64));
	if (ret)
	{
		printk("Backend public key decode failed\n");
		return ret;
	}

	ret = mbedtls_pk_parse_public_key(&backend_pk, der_buf, der_len);
	if (ret)
	{
		printk("Backend public key parse failed\n");
		mbedtls_pk_free(&backend_pk);
		return -EINVAL;
	}

	backend_pk_ready = true;
	return 0;
}

ssize_t token_write(struct bt_conn *conn, const struct bt_gatt_attr *attr,
					const void *buf, uint16_t len, uint16_t offset, uint8_t flags)
{
	ARG_UNUSED(attr);
	char *json = (char *)token_buf;

	if (bt_conn_get_security(conn) < BT_SECURITY_L2)
	{
		/* Request encryption and ask the client to retry */
		(void)bt_conn_set_security(conn, BT_SECURITY_L2);
		return BT_GATT_ERR(BT_ATT_ERR_AUTHENTICATION);
	}

	if (flags & BT_GATT_WRITE_FLAG_PREPARE)
	{
		if (offset + len > sizeof(token_buf))
		{
			return BT_GATT_ERR(BT_ATT_ERR_INVALID_ATTRIBUTE_LEN);
		}
		memcpy(token_buf + offset, buf, len);
		token_buf_len = MAX(token_buf_len, offset + len);
		return len;
	}

	if (flags & BT_GATT_WRITE_FLAG_EXECUTE)
	{
		/* Execute long write */
		len = token_buf_len;
		if (len == 0 || len >= sizeof(token_buf))
		{
			return BT_GATT_ERR(BT_ATT_ERR_INVALID_ATTRIBUTE_LEN);
		}
		token_buf[len] = '\0';
		token_buf_len = 0;
	}
	else
	{
		if (offset != 0)
		{
			return BT_GATT_ERR(BT_ATT_ERR_INVALID_OFFSET);
		}

		if (len >= sizeof(token_buf))
		{
			return BT_GATT_ERR(BT_ATT_ERR_INVALID_ATTRIBUTE_LEN);
		}
	}

	/* Fragmented send from app: FRAG_HDR / FRAG */
	char type[16];
	if (!(flags & BT_GATT_WRITE_FLAG_EXECUTE))
	{
		if (len >= sizeof(token_cmd_buf))
		{
			return BT_GATT_ERR(BT_ATT_ERR_INVALID_ATTRIBUTE_LEN);
		}
		memcpy(token_cmd_buf, buf, len);
		token_cmd_buf[len] = '\0';
		if (json_extract_string(token_cmd_buf, "type", type, sizeof(type)))
		{
			if (strcmp(type, "FRAG_HDR") == 0)
			{
				uint32_t total_len = 0;
				if (!json_extract_uint(token_cmd_buf, "len", &total_len))
				{
					return len;
				}
				if (total_len == 0 || total_len > sizeof(token_buf))
				{
					return len;
				}
				memset(&token_frag, 0, sizeof(token_frag));
				token_frag.expected_len = total_len;
				token_frag.buf_len = 0;
				token_buf_len = 0;
				return len;
			}
			else if (strcmp(type, "FRAG") == 0)
			{
				char data_b64[256];
				if (!json_extract_string(token_cmd_buf, "data", data_b64, sizeof(data_b64)))
				{
					return len;
				}
				if (token_frag.expected_len == 0)
				{
					return len;
				}
				uint8_t chunk[256];
				size_t chunk_len = 0;
				if (base64_decode_str(data_b64, chunk, sizeof(chunk), &chunk_len))
				{
					return len;
				}
				if (token_frag.buf_len + chunk_len > sizeof(token_buf))
				{
					return BT_GATT_ERR(BT_ATT_ERR_INVALID_ATTRIBUTE_LEN);
				}
				memcpy(token_buf + token_frag.buf_len, chunk, chunk_len);
				token_frag.buf_len += chunk_len;

				if (token_frag.buf_len >= token_frag.expected_len)
				{
					size_t total = token_frag.buf_len;
					if (total >= sizeof(token_buf))
					{
						return BT_GATT_ERR(BT_ATT_ERR_INVALID_ATTRIBUTE_LEN);
					}
					token_buf[total] = '\0';
					memset(&token_frag, 0, sizeof(token_frag));
					token_buf_len = 0;
					return process_token_json(conn, attr, (char *)token_buf, total);
				}
				return len;
			}
		}
	}

	if (!(flags & BT_GATT_WRITE_FLAG_EXECUTE))
	{
		memcpy(token_buf, buf, len);
		token_buf[len] = '\0';
		token_buf_len = 0;
	}

	/* Non-fragmented path: process directly */
	return process_token_json(conn, attr, json, len);
}

void token_ccc_changed(const struct bt_gatt_attr *attr, uint16_t value)
{
	ARG_UNUSED(attr);
	token_notify_enabled = (value == BT_GATT_CCC_NOTIFY) ? BT_GATT_CCC_NOTIFY : 0;
	if (token_notify_enabled == BT_GATT_CCC_NOTIFY && secure_ready_pending && current_conn)
	{
		secure_ready_pending = false;
		token_notify_secure_ready(current_conn);
	}
}

void token_force_notify_enable(void)
{
	token_notify_enabled = BT_GATT_CCC_NOTIFY;
}

void token_reset(void)
{
	memset(last_token_status, 0, sizeof(last_token_status));
	memset(&token_frag, 0, sizeof(token_frag));
	token_notify_enabled = 0;
	token_buf_len = 0;
	secure_ready_pending = false;
}

void token_set_attr(const struct bt_gatt_attr *attr)
{
	token_attr = attr;
}

void token_notify_secure_ready(struct bt_conn *conn)
{
	if (!token_attr || token_notify_enabled != BT_GATT_CCC_NOTIFY)
	{
		secure_ready_pending = true;
		return;
	}
	snprintk(last_token_status, sizeof(last_token_status),
			 "{\"type\":\"SECURE_READY\",\"status\":\"OK\"}");
	notify_json(conn, token_attr, last_token_status, token_notify_enabled);
}
```

## src/authorizationtoken.h
```c
#pragma once

#include <zephyr/bluetooth/conn.h>
#include <zephyr/bluetooth/gatt.h>

int auth_init_backend_public_key(void);
ssize_t token_write(struct bt_conn *conn, const struct bt_gatt_attr *attr,
					const void *buf, uint16_t len, uint16_t offset, uint8_t flags);
void token_ccc_changed(const struct bt_gatt_attr *attr, uint16_t value);
void token_force_notify_enable(void);
void token_reset(void);
void token_set_attr(const struct bt_gatt_attr *attr);
void token_notify_secure_ready(struct bt_conn *conn);
```

## src/challengeresponse.h
```c
#pragma once

#include <stddef.h>
#include <zephyr/bluetooth/conn.h>
#include <zephyr/bluetooth/gatt.h>

int challenge_load_device_secret(void);
int challenge_settings_init(void);
int challenge_send_nonce(struct bt_conn *conn);
void challenge_get_last_json(const char **json, size_t *len);
int challenge_process_response_json(struct bt_conn *notify_conn,
									const char *json, size_t len);
ssize_t challenge_read(struct bt_conn *conn, const struct bt_gatt_attr *attr,
					   void *buf, uint16_t len, uint16_t offset);
ssize_t response_write(struct bt_conn *conn, const struct bt_gatt_attr *attr,
					   const void *buf, uint16_t len, uint16_t offset, uint8_t flags);
void challenge_ccc_changed(const struct bt_gatt_attr *attr, uint16_t value);
void challenge_force_notify_enable(void);
void challenge_set_attr(const struct bt_gatt_attr *attr);
void challenge_reset(void);
void challenge_reset_preserve_expected(void);
bool challenge_link_pending(void);
int challenge_set_link_key_hex(const char *hex);
void challenge_set_expected_keyfob_id(const char *id);
```
